/***********************************************
 *	auther:YI
 *	time:2020-1-13-23:42
 *
 *	Ran接矩阵行(JP19(绿)/20(红))
 *	Col接矩阵列(JP12)
 *	只需要修改页内容
************************************************/

#include <reg51.h>
#include <intrins.h>
typedef unsigned char u8;
typedef unsigned int u16;                                                                                        
typedef unsigned long u32;
void delayms(u32 ms);		//延时函数

#define Row P0
#define Col_red P2
#define Col_gre P3

u8 code Row_vlu[8]={0x80,0x40,0x20,0x10,0x08,0x04,0x02,0x01};
u8 code Col_red_vlu[]={
0xFF,0xBD,0xDB,0xE7,0xE7,0xDB,0xBD,0xFF,
0xDF,0xDF,0xC7,0xDB,0xDB,0xE7,0xFF,0xFF,
0xBD,0x9D,0xAD,0xB5,0xB9,0xBD,0xFF,0x87,
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0xFF,0xFF,0xFF,0xFF,0xFF,0xFF,0xFF,0xFF,/*"未命名文件",0*/
};
u8 code Col_gre_vlu[]={0xff};

void main()
{
	u8 i,j,m;
	while(1)
	{
		for(j=0;j<sizeof(Col_red_vlu)-8;j++)
		{
			for(m=0;m<30;m++)
			{
				for(i=0;i<8;i++)
				{
					Row = Row_vlu[i];
					Col_red = Col_red_vlu[i+j];
					Col_gre = Col_gre_vlu[i+j];
					delayms(1);
					Col_red = 0xff;
					Col_gre = 0xff;
				}
			}
		}
	}
	
}	
	
void delayms(u32 ms)
{
	u8 i;
	while(ms--)
	{
		for(i=0;i<85;i++);
	}
}
	
